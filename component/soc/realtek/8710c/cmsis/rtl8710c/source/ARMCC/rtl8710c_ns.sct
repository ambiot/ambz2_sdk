; *************************************************************
; *** Scatter-Loading Description File for RTL8710C NS      ***
; *************************************************************
LR_ITCM_ROM 0x00019000 0x00045C00  {    ; load region size_region
  _ROM_NS_VECTOR_TBL 0x00019000 FIXED {  ; load address = execution address
		*.o (.rom_ns.vectors)
  }

  _ROM_CODE +0 FIXED  {  ; load address = execution address
    startup_rtl8710c.o (+RO)
    system_rtl8710c.o (+RO)

	rtl8710c_syson.o (+RO)
	rtl8710c_uart.o (+RO)
	rtl8710c_gdma.o (+RO)
	rtl8710c_gdma.o (+RO)
	rtl8710c_i2c.o (+RO)
	rtl8710c_i2c.o (+RO)
	rtl8710c_crypto.o (+RO)
	rtl8710c_crypto.o (+RO)
	rtl8710c_lpi.o (+RO)
	rtl8710c_sdio_dev.o (+RO)

	xprintf.o (+RO)
	rtl_printf.o (+RO)
	strproc.o (+RO)
	strproc.o (+RO)
	atoi.o (+RO)
	atoi.o (+RO)
	rt_scanf.o (+RO)
	rt_scanf.o (+RO)

	startup_rtl8710c.o (+RO)
	startup.o (+RO)
	consol_cmds.o (+RO)
	shell.o (+RO)
	xprintf.o (+RO)
	rtl_printf.o (+RO)
	utility.o (+RO)

	rtl8710c_syson.o (+RO)
	rtl8710c_irq.o (+RO)
	rtl8710c_timer.o (+RO)
	rtl8710c_pwm.o (+RO)
	rtl8710c_uart.o (+RO)
	rtl8710c_gdma.o (+RO)
	rtl8710c_spic.o (+RO)
	rtl8710c_flash.o (+RO)
	rtl8710c_gpio.o (+RO)
	rtl8710c_i2c.o (+RO)
	rtl8710c_lpi.o (+RO)
	rtl8710c_misc.o (+RO)
	rtl8710c_sdio_dev.o (+RO)
	rtl8710c_uart.o (+RO)
	rtl8710c_gdma.o (+RO)
	rtl8710c_ssi.o (+RO)
	rtl8710c_misc.o (+RO)

	rom_rtw_message_e.o (+RO)
	rom_rtw_message_f.o (+RO)
	rom_mbedtls_bignum.o (+RO)
	rom_mbedtls_ecp.o (+RO)
	rom_mbedtls_ecp_curves.o (+RO)
	rom_mbedtls_oid.o (+RO)
	rom_mbedtls_md.o (+RO)
	rom_mbedtls_md_wrap.o (+RO)
	rom_mbedtls_pem.o (+RO)
	rom_mbedtls_dhm.o (+RO)
	rom_mbedtls_ecjpake.o (+RO)
	rom_mbedtls_pk.o (+RO)
	rom_mbedtls_pk_wrap.o (+RO)
	rom_mbedtls_pkwrite.o (+RO)

	*.o (.startup.text)
	*.o (.vector.text)
	*.o (.sysstart.text)
	*.o (.sys_misc.text)
	*.o (.rom.irq.rodata)

	; HAL ROM Code 
	*.o (.rom.hal_syson.text)
	*.o (.rom.hal_syson.rodata)
	*.o (.rom.hal_uart.text)
	*.o (.rom.hal_uart.rodata)
	*.o (.rom.hal_timer.text)
	*.o (.rom.hal_timer.rodata)
	*.o (.rom.hal_timer_ba.rodata)
	*.o (.rom.hal_pwm.text)
	*.o (.rom.hal_pwm.rodata)
	*.o (.rom.hal_gpio.text)
	*.o (.rom.hal_gpio.rodata)
	*.o (.rom.hal_gdma.text*)
	*.o (.rom.hal_gdma.rodata*)
	*.o (.rom.hal_spic.text*)
	*.o (.rom.hal_spic.rodata*)
	*.o (.rom.hal_flash.text*)
	*.o (.rom.hal_flash.rodata*)
	*.o (.rom.hal_ssi.text*)
	*.o (.rom.hal_ssi.rodata*)
	*.o (.rom.hal_cache.text*)
	*.o (.rom.hal_cache.rodata*)
	*.o (.rom.hal_i2c.text*)
	*.o (.rom.hal_i2c.rodata*)
	*.o (.rom.hal_lpi.text*)
	*.o (.rom.hal_lpi.rodata*)
	*.o (.rom.hal_sdiod.text*)
	*.o (.rom.hal_sdiod.rodata*)

	; Utility ROM code
	*.o (.infra.rom.text)
	*.o (.stdioport.text)
	*.o (.stdioport.rodata)
	*.o (.xprintf.text)
	*.o (.xprintf.rodata)
	*.o (.rtlprintf.text)
	*.o (.rtlprintf.rodata)
	*.o (.rtlprintf.text)
	*.o (.logbuf.text)
	*.o (.shell.text)
	*.o (.shell.rodata)
	*.o (.shellcmd.text)
	*.o (.shellcmd.rodata)
	*.o (.ccmd.text)
	*.o (.ccmd.rodata)
	*.o (.rom.utility.text*)


	; WLAN ROM code
	*.o (.rom.wlan.text)
	*.o (.rom.wlan.rodata)

	; Apple crypto ROM code
	*.o (.rom.apple.text)
	*.o (.rom.apple.rodata)


	; SSL ROM code
	*.o (.rom.ssl.text)
	*.o (.rom.ssl.rodata)

	*.o (.rom.ssl.itcm)
	*.o (.rom.apple.itcm)
	*.o (.rom.ssl.dtcm)
	*.o (.rom.apple.dtcm)

	; FAAC ROM code
	*.o (.rom.faac.text)
	*.o (.rom.faac.rodata)  	
  }

  _ROM_DATA 0x1003FD00 0x100  {
	system_rtl8710c.o(.data*)
	rtl8710c_handler_ns.o(.data*)
	rtl8710c_irq.o(.data*)
	rtl8710c_symbns4s.o(.data*)
	startup_ns.o(.data*)
	rtl8710c_i2c.o(.data*)
	rtl8710c_crypto.o(.data*)
	* (.rom.hal_uart.data)
	* (.rom.hal_timer.data)
	* (.rom.hal_pwm.data)
	* (.rom.hal_gpio.data)
	* (.rom.hal_cache.data)
	* (.rom.hal_gdma.data)
	* (.rom.hal_crypto_ns.data)
	* (.rom.hal_ssi.data)
	* (.rom.hal_i2c.data)
	* (.xprintf.data)
  }  
}

LR_ROM_STUB 0x0005EC00 0x00001380  {    ; load region size_region

  _STUB_SYSON 0x0005EC00 FIXED {  ; load address = execution address
		*.o (.rom.hal_syson.stubs)
  }

  _STUB_TMR AlignExpr(+0, 0x10) FIXED {  ; load address = execution address
		*.o (.rom.hal_timer.stubs)
  }

  _STUB_INT_VECTOR AlignExpr(+0, 0x10) FIXED {  ; load address = execution address
		*.o (.rom.hal_vector.stubs)
  }

  _STUB_CRYPTO AlignExpr(+0, 0x10) FIXED {  ; load address = execution address
		*.o (.rom.hal_crypto_ns.stubs)
  }

  _STUB_PWM AlignExpr(+0, 0x10) FIXED {  ; load address = execution address
		*.o (.rom.hal_pwm.stubs)
  }

  _STUB_UART AlignExpr(+0, 0x10) FIXED {  ; load address = execution address
		*.o (.rom.hal_uart.stubs)
  }

  _STUB_GPIO AlignExpr(+0, 0x10) FIXED {  ; load address = execution address
		*.o (.rom.hal_gpio.stubs)
  }

  _STUB_GDMA AlignExpr(+0, 0x10) FIXED {  ; load address = execution address
		*.o (.rom.hal_gdma.stubs)
  }

  _STUB_SPIC AlignExpr(+0, 0x10) FIXED {  ; load address = execution address
		*.o (.rom.hal_spic.stubs)
  }

  _STUB_FLASH AlignExpr(+0, 0x10) FIXED {  ; load address = execution address
		*.o (.rom.hal_flash.stubs)
  }

  _STUB_SSI AlignExpr(+0, 0x10) FIXED {  ; load address = execution address
		*.o (.rom.hal_ssi.stubs)
  }

  _STUB_CACHE AlignExpr(+0, 0x10) FIXED {  ; load address = execution address
		*.o (.rom.hal_cache.stubs)
  }
		
  _STUB_I2C AlignExpr(+0, 0x10) FIXED {  ; load address = execution address
		*.o (.rom.hal_i2c.stubs)
  }

  _STUB_MISC AlignExpr(+0, 0x10) FIXED {  ; load address = execution address
		*.o (.rom.hal_misc.stubs)
  }
		
  _STUB_LPI AlignExpr(+0, 0x10) FIXED {  ; load address = execution address
		*.o (.rom.hal_lpi.stubs)
  }

  _STUB_SDIOD AlignExpr(+0, 0x10) FIXED {  ; load address = execution address
		*.o (.rom.hal_sdiod.stubs)
  }

  _STUB_SHELL AlignExpr(+0, 0x10) FIXED {  ; load address = execution address
		*.o (.rom.shellcmd.stubs)
  }
				
  _STUB_PRINTFNS AlignExpr(+0, 0x10) FIXED {  ; load address = execution address
		*.o (.rom.printf.stubs)
  }

  _STUB_STRPROC AlignExpr(+0, 0x10) FIXED {  ; load address = execution address
		*.o (.rom.strproc.stubs)
  }

  _STUB_UTILITY AlignExpr(+0, 0x10) FIXED {  ; load address = execution address
		*.o (.rom.utility.stubs)
  }

  _STUB_WLAN AlignExpr(+0, 0x10) FIXED {  ; load address = execution address
		*.o (.rom.wlan.stubs)
  }

  _STUB_APPLE AlignExpr(+0, 0x10) FIXED {  ; load address = execution address
		*.o (.rom.apple.stubs)
  }

  _STUB_SSL AlignExpr(+0, 0x10) FIXED {  ; load address = execution address
		*.o (.rom.ssl.stubs)
  }

  _STUB_FAAC AlignExpr(+0, 0x10) FIXED {  ; load address = execution address
		*.o (.rom.faac.stubs)
  }

  _STUB_NS4S 0x0005FF80 FIXED 0x00000080 {  ; load address = execution address
		*.o (.rom.ns4s.stubs)
  }
}

LR_DTCM_RAM 0x10008000 0x00038000  {    ; load region size_region
  _RAM_CODE 0x20100E00 FIXED {
    .ANY (+RO)
  }
  
  _DATA +0 FIXED {
    .ANY (+RW)
  }

  _BSS +0 UNINIT FIXED {
    .ANY (+ZI)
  }

  _ROM_TEMP_BSS 0x1002F000 UNINIT FIXED {
    * (.rom_temp.bss)
  }

  _DTCM_RAM +0 UNINIT FIXED{
  	rtl8710c_handler_ns.o (.heap)
  }
  
  _STACK 0x10028000 0x00001000  {
    rtl8710c_handler_ns.o (.stack)
  }

  _RAM_FUNC_TBL 0x1003FC80 FIXED {
    ram_start.o (.start.ram.data*)
  }

  _ROM_BSS 0x1003FD00 FIXED UNINIT {
	*.o (.sysstart.bss)
	*.o (.sys_misc.bss)
	*.o (.diag.bss)
	*.o (.rom.hal_syson.bss)
	*.o (.rom.hal_uart.bss)
	*.o (.rom.hal_timer.bss)
	*.o (.rom.hal_pwm.bss)
	*.o (.rom.hal_gpio.bss)
	*.o (.rom.hal_i2c.bss)
	*.o (.rom.hal_gdma.bss)
	*.o (.rom.hal_spic.bss)
	*.o (.rom.hal_flash.bss)
	*.o (.rom.hal_ssi.bss)
	*.o (.rom.hal_cache.bss)
	*.o (.rom.hal_crypto_ns.bss)
	*.o (.rom.hal_lpi.bss)
	*.o (.rom.hal_sdiod.bss)
	*.o (.xprintf.bss)
	*.o (.logbuf.bss)
	*.o (.stdioport.bss)

	*.o (.rom.wlan.bss)
	*.o (.rom.ssl.bss)
	*.o (.rom.hal_crypto_ns.bss)

	strproc.o(+ZI)
	rtl8710c_i2c.o(+ZI)
	rtl8710c_flash.o(+ZI)    
  }

  _RAM_VECTOR 0x1003FF00 FIXED {  ; RW data
	ram_start.o (.ram_vector_table)
	rtl8195bhp_vectors_ns.o (.ram_vector_table)
  }

  _RAM_IRQ_TABL +0 FIXED {  ; RW data
	*.o (.rom.irq.bss)
  }

}