; *************************************************************
; *** Scatter-Loading Description File for RTL8195BHP       ***
; *************************************************************
LR_ITCM 0x00000000 0x001FF000  {    ; load region size_region
  _ITCM_ROM 0x00000000 0x00003000  {  ; load address = execution address
   startup_rtl8195bhp.o (.rom.vectors, +First)
   *(InRoot$$Sections)

	startup_rtl8195bhp.o (+RO)
	startup.o (+RO)
	fw_flash_boot.o (+RO)
  }
}

LR_ROM 0x1006F000 0x00041000  {    ; load region size_region
  _ROM_CODE 0x1006F000 0x00040000  {  ; Text & RO data
	rtl8195bhp_vectors.o (+RO)
	system_rtl8195bhp.o (+RO)
	rtl8195bhp_misc.o (+RO)
   
	*(.rom.hal_uart.rodata)
	*(.rom.hal_timer.rodata)
	*(.rom.hal_timer_ba.rodata)
	*(.rom.hal_icc.text)
	*(.rom.hal_icc.rodata)
	*(.rom.hal_efuse.text)
	*(.rom.hal_efuse.rodata)
	*(.rom.hal_gdma.text)
	*(.rom.hal_gdma.rodata)
	*(.rom.hal_sce.text)
	*(.rom.hal_sce.rodata)
	
	rtl8195bhp_uart.o (+RO)
	rtl8195bhp_timer.o (+RO)
	rtl8195bhp_icc.o (+RO)
	rtl8195bhp_efuse.o (+RO)
	rtl8195bhp_gdma.o (+RO)
	rtl8195blp_pinmux.o (+RO)
	rtl8195blp_sce.o (+RO)
    
	strproc.o (+RO)
	memcmp.o (+RO)
	memcpy.o (+RO)
	memmove.o (+RO)
	memset.o (+RO)
	strtod.o (+RO)
	strtol.o (+RO)
	strtoul.o (+RO)
	strtoull.o (+RO)
	strtoll.o (+RO)
	div_u64.o (+RO)
	rand.o (+RO)
	utility.o (+RO)

	rtl_printf.o (+RO)
	stdio_port.o (+RO)

	libshutdown.o (+RO)
	libshutdown2.o (+RO)
	rtexit.o (+RO)
	rtexit2.o (+RO)
	llmul.o (+RO)
	llsdiv.o (+RO)
	lludiv.o (+RO)
	exit.o (+RO)
	aeabi_sdiv.o (+RO)
	heapauxi.o (+RO)
	d2f.o (+RO)
	daddsub.o (+RO)
	ddiv.o (+RO)
	dfixl.o (+RO)
	dfixui.o (+RO)
	dflti.o (+RO)
	dmul.o (+RO)
	fdiv.o (+RO)
	dcmpin.o (+RO)
	cmpret.o (+RO)
	dnan2.o (+RO)
	sys_exit.o (+RO)
	retnan.o (+RO)
	use_no_semi.o (+RO)
	dlef.o (+RO)
	faddsub.o (+RO)
	fmul.o (+RO)
	faddsub.o (+RO)
	usenofp.o (+RO)
  }

  _ROM_DATA 0x20157700 0x100  {
    system_rtl8195bhp.o (+RW)
    * (.rom.hal_uart.data)
	* (.rom.hal_timer.data)
	* (.rom.hal_icc.data)
	* (.rom.hal_efuse.data)
  }

  _STUB_SYSON 0x100AEC00 FIXED {  ; load address = execution address
		*.o (.rom.hal_syson.stubs)
  }

  _STUB_TMR AlignExpr(+0, 0x10) FIXED {  ; load address = execution address
		*.o (.rom.hal_timer.stubs)
  }

  _STUB_INT_VECTOR AlignExpr(+0, 0x10) FIXED {  ; load address = execution address
		*.o (.rom.hal_vector.stubs)
  }

  _STUB_CRYPTO AlignExpr(+0, 0x10) FIXED {  ; load address = execution address
		*.o (.rom.hal_crypto_s.stubs)
  }

  _STUB_UART AlignExpr(+0, 0x10) FIXED {  ; load address = execution address
		*.o (.rom.hal_uart.stubs)
  }

  _STUB_ICC AlignExpr(+0, 0x10) FIXED {  ; load address = execution address
		*.o (.rom.hal_icc.stubs)
  }

  _STUB_EFUSE AlignExpr(+0, 0x10) FIXED {  ; load address = execution address
		*.o (.rom.hal_efuse.stubs)
  }

  _STUB_GDMA AlignExpr(+0, 0x10) FIXED {  ; load address = execution address
		*.o (.rom.hal_gdma.stubs)
  }

  _STUB_SPIC AlignExpr(+0, 0x10) FIXED {  ; load address = execution address
		*.o (.rom.hal_spic.stubs)
  }

  _STUB_FLASH AlignExpr(+0, 0x10) FIXED {  ; load address = execution address
		*.o (.rom.hal_flash.stubs)
  }

  _STUB_PINMUX AlignExpr(+0, 0x10) FIXED {  ; load address = execution address
		*.o (.rom.hal_pinmux.stubs)
  }

  _STUB_CACHE AlignExpr(+0, 0x10) FIXED {  ; load address = execution address
		*.o (.rom.hal_cache.stubs)
  }

  _STUB_SCE AlignExpr(+0, 0x10) FIXED {  ; load address = execution address
		*.o (.rom.hal_sce.stubs)
  }

  _STUB_MISC AlignExpr(+0, 0x10) FIXED {  ; load address = execution address
		*.o (.rom.hal_misc.stubs)
  }

  _STUB_SBOOT AlignExpr(+0, 0x10) FIXED {  ; load address = execution address
		*.o (.rom.sboot.stubs)
  }

  _STUB_PRINTFS AlignExpr(+0, 0x10) FIXED {  ; load address = execution address
		*.o (.rom.printf.stubs)
  }

  _STUB_STRPROC AlignExpr(+0, 0x10) FIXED {  ; load address = execution address
		*.o (.rom.strproc.stubs)
  }

  _STUB_UTILITY AlignExpr(+0, 0x10) FIXED {  ; load address = execution address
		*.o (.rom.utility.stubs)
  }

}

LR_DTCM 0x20000000 0x00008000  {    ; load region size_region

  _ROM_TEMP_BSS 0x20000000 UNINIT {
    * (.rom_temp.bss)
  }

  _ROM_SBOOT_BSS +0 UNINIT FIXED {
    * (.rom.sboot.bss)
  }

  _DTCM_RAM +0 UNINIT {
  	* (.dtcm.ram)
    startup_rtl8195bhp.o (.heap)
  }

  _STACK 0x20007000 0x00001000  {
    startup_rtl8195bhp.o (.stack)
  }
}

LR_RAM 0x20138000 0x00020000  {    ; load region size_region
  EXEC_NSCR 0x20138000 0x8000  {
    * (Veneer$$CMSE)
  }

  _RAM_CODE 0x20140000 FIXED {
   .ANY (+RO)
  }
  
  _DATA +0 FIXED {
   .ANY (+RW)
  }

  _BSS +0 UNINIT FIXED {
    RTX_Conf_CM.o (+ZI)
      .ANY (+ZI)
  }

  _RAM_FUNC_TBL 0x20157600 FIXED 0xF0 {
    ram_start.o (.start.ram.data*)
  }

  _RAM_IMG_SIGN 0x201576F0 FIXED 0x10  {
    ram_start.o (.start.ram.sign*)
  }
 
  _ROM_BSS 0x20157800 FIXED UNINIT {
	* (.sysstart.bss)
	* (.sys_misc.bss)
	* (.diag.bss)
	* (.rom.hal_syson.bss)
	* (.rom.hal_uart.bss)
	* (.rom.hal_timer.bss)
	* (.rom.hal_icc.bss)
	* (.rom.hal_efuse.bss)
	* (.rom.hal_gdma.bss)
	* (.rom.hal_spic.bss)
	* (.rom.hal_flash.bss)        
	* (.rom.hal_pinmux.bss)
	* (.rom.hal_cache.bss)
	* (.rom.hal_sce.bss)
	* (.infra.rom.bss)
	* (.stdioport.bss)
	* (.rom.wlan.bss)
	* (.rom.hal_crypto_s.bss)
    strproc.o (+ZI)	
    rtl8195bhp_gdma.o (+ZI)	
	rtl8195blp_pinmux.o (+ZI)  	
  }

  _RAM_VECTOR 0x20157E00 FIXED 0x100 {  ; RW data
	rtl8195bhp_vectors.o (.ram_vector_table)
  }

  _RAM_IRQ_TABL 0x20157F00 FIXED 0x100 {  ; RW data
	rtl8195bhp_vectors.o (.ram_user_irq_table)
  }

}
